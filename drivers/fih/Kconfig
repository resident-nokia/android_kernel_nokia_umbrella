## drivers/fih/Kconfig
```kconfig
menu "Device Drivers for FIH"

  config FIH_NB1
  	bool "FIH NB1 project"
  	default n
  	help
  	  support fih NB1 project

  config FIH_A1N
  	bool "FIH A1N project"
  	default n
  	help
  	  support fih A1N project

  config FIH_APR
           bool "fih apr"
           default n
           help
             support fih apr virtual file

  config FIH_INFO
	  bool "fih info"
	  default n
	  help
	    support fih information virtual file

  config FIH_E2P
	  bool "fih e2p"
	  default n
	  help
	    support fih e2p virtual file

  config FIH_CPU
	  bool "fih cpu"
	  default n
	  help
	    support fih cpu info virtual file

  config FIH_DRAM
	  bool "fih DRAM"
	  default n
	  help
	    support fih DRAM info virtual file

  config FIH_HWID
	  bool "fih hwid"
	  default n
	  help
	    support fih hwid module

  config FIH_DLOAD
           bool "fih download mode by bset enable"
           default n
           help
             support fih download mode by bset enable

config FIH_HALL_SENSOR
	bool "FIH HALL Sensor"
	default n
	help
	  support FIH HALL Sensor


  config FIH_GPIO
      bool "fih gpio"
      default n
      help
        support fih gpio function

endmenu
```
